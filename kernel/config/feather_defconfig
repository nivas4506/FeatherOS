## kernel/config/feather_defconfig
```kconfig
#
# FeatherOS Linux Kernel 6.x Base Layer defconfig
# Minimal, hardened, fast-boot kernel configuration
#

# Architecture & General
CONFIG_64BIT=y
CONFIG_X86_64=y
CONFIG_SMP=y
CONFIG_NR_CPUS=64
CONFIG_PREEMPT=y
CONFIG_NO_HZ_FULL=y
CONFIG_HIGH_RES_TIMERS=y

# Namespaces & Containerization (Required for aegis-exec Sandboxing)
CONFIG_NAMESPACES=y
CONFIG_UTS_NS=y
CONFIG_IPC_NS=y
CONFIG_USER_NS=y
CONFIG_PID_NS=y
CONFIG_NET_NS=y
CONFIG_CGROUPS=y
CONFIG_MEMCG=y
CONFIG_CGROUP_SCHED=y
CONFIG_CGROUP_PIDS=y
CONFIG_CGROUP_BPF=y

# Security & Sandboxing
CONFIG_SECURITY=y
CONFIG_SECCOMP=y
CONFIG_SECCOMP_FILTER=y
CONFIG_BPF_SYSCALL=y
CONFIG_BPF_JIT=y
CONFIG_BPF_EVENTS=y
CONFIG_SECURITY_LANDLOCK=y

# Memory Management
CONFIG_SLUB=y
CONFIG_TRANSPARENT_HUGEPAGE=y
CONFIG_KSM=y

# Storage & Filesystems
CONFIG_EXT4_FS=y
CONFIG_EXT4_FS_POSIX_ACL=y
CONFIG_BTRFS_FS=y
CONFIG_OVERLAY_FS=y
CONFIG_TMPFS=y
CONFIG_TMPFS_POSIX_ACL=y
CONFIG_DEVTMPFS=y
CONFIG_DEVTMPFS_MOUNT=y
CONFIG_CONFIGFS_FS=y
CONFIG_PROC_FS=y
CONFIG_SYSFS=y

# Networking
CONFIG_NET=y
CONFIG_INET=y
CONFIG_UNIX=y
CONFIG_AF_XDP=y
CONFIG_NETFILTER=y
CONFIG_TCP_CONG_BBR=y

# Virtualization & VirtIO Drivers (QEMU / Cloud base)
CONFIG_VIRTIO=y
CONFIG_VIRTIO_PCI=y
CONFIG_VIRTIO_BALLOON=y
CONFIG_VIRTIO_BLK=y
CONFIG_VIRTIO_NET=y
CONFIG_VIRTIO_CONSOLE=y
CONFIG_VIRTIO_RNG=y
CONFIG_VIRTIO_FS=y

# Modern Fast I/O
CONFIG_IO_URING=y
CONFIG_BLK_DEV_NVME=y
CONFIG_SCSI=y
CONFIG_BLK_DEV_SD=y
```
